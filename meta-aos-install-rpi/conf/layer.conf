## meta-aos-install-rpi/conf/layer.conf
```bitbake
# We have a conf and classes directory, append to BBPATH
BBPATH .= ":${LAYERDIR}"

# We have a recipes directory containing .bb and .bbappend files, add to BBFILES
BBFILES += "${LAYERDIR}/recipes*/*.bb \
            ${LAYERDIR}/recipes*/*.bbappend \
            ${LAYERDIR}/recipes*/*/*.bb \
            ${LAYERDIR}/recipes*/*/*.bbappend"

BBFILE_COLLECTIONS += "aos-install-rpi"
BBFILE_PATTERN_aos-install-rpi = "^${LAYERDIR}"
BBFILE_PRIORITY_aos-install-rpi = "16"

LAYERSERIES_COMPAT_aos-install-rpi = "scarthgap"
```

## meta-aos-rpi-domd-common/conf/distro/aos-core.conf
```bitbake
include conf/distro/poky.conf

DISTRO = "aos-core"
DISTRO_NAME = "AosCore"
DISTRO_VERSION = "${AOS_ROOTFS_IMAGE_VERSION}"
SDK_VENDOR = "-aossdk"
SDK_VERSION="${AOS_ROOTFS_IMAGE_VERSION}"
SDK_VERSION[vardepvalue] = "${AOS_ROOTFS_IMAGE_VERSION}"
SDK_NAME = "${DISTRO}-${SDKMACHINE}"
SDKPATHINSTALL = "/opt/${DISTRO}-sdk/${MACHINE}/${SDK_VERSION}"
TOOLCHAIN_OUTPUTNAME = "${SDK_NAME}-toolchain-${MACHINE}-${SDK_VERSION}"
TARGET_VENDOR = "-aos"
```

## meta-aos-rpi-domd-common/conf/layer.conf
```bitbake
# We have a conf and classes directory, append to BBPATH
BBPATH .= ":${LAYERDIR}"

# We have a recipes directory containing .bb and .bbappend files, add to BBFILES
BBFILES += "${LAYERDIR}/recipes*/*/*.bb \
            ${LAYERDIR}/recipes*/*/*.bbappend"

BBFILE_COLLECTIONS += "aos-rpi-domd-common"
BBFILE_PATTERN_aos-rpi-domd-common := "^${LAYERDIR}/"
BBFILE_PRIORITY_aos-rpi-domd-common = "14"

LAYERSERIES_COMPAT_aos-rpi-domd-common = "scarthgap"
```

## meta-aos-rpi-domd-main/conf/layer.conf
```bitbake
# We have a conf and classes directory, append to BBPATH
BBPATH .= ":${LAYERDIR}"

# We have a recipes directory containing .bb and .bbappend files, add to BBFILES
BBFILES += "${LAYERDIR}/recipes*/*/*.bb \
            ${LAYERDIR}/recipes*/*/*.bbappend"

BBFILE_COLLECTIONS += "aos-rpi-domd-main"
BBFILE_PATTERN_aos-rpi-domd-main := "^${LAYERDIR}/"
BBFILE_PRIORITY_aos-rpi-domd-main = "15"

LAYERSERIES_COMPAT_aos-rpi-domd-main = "scarthgap"
```

## meta-aos-rpi-domd-node/conf/layer.conf
```bitbake
# We have a conf and classes directory, append to BBPATH
BBPATH .= ":${LAYERDIR}"

# We have a recipes directory containing .bb and .bbappend files, add to BBFILES
BBFILES += "${LAYERDIR}/recipes*/*/*.bb \
            ${LAYERDIR}/recipes*/*/*.bbappend"

BBFILE_COLLECTIONS += "aos-rpi-domd-node"
BBFILE_PATTERN_aos-rpi-domd-node := "^${LAYERDIR}/"
BBFILE_PRIORITY_aos-rpi-domd-node = "15"

LAYERSERIES_COMPAT_aos-rpi-domd-node = "scarthgap"
```

## meta-aos-rpi-install/conf/layer.conf
```bitbake
# We have a conf and classes directory, append to BBPATH
BBPATH .= ":${LAYERDIR}"

# We have a recipes directory containing .bb and .bbappend files, add to BBFILES
BBFILES += "${LAYERDIR}/recipes*/*.bb \
            ${LAYERDIR}/recipes*/*.bbappend \
            ${LAYERDIR}/recipes*/*/*.bb \
            ${LAYERDIR}/recipes*/*/*.bbappend"

BBFILE_COLLECTIONS += "aos-rpi-install"
BBFILE_PATTERN_aos-rpi-install = "^${LAYERDIR}"
BBFILE_PRIORITY_aos-rpi-install = "16"

LAYERSERIES_COMPAT_aos-rpi-install = "scarthgap"
```
